/*
 * Copyright (c) 2021 The ZMK Contributors
 *
 * SPDX-License-Identifier: MIT
 */

#include <dt-bindings/zmk/keys.h>

/ {
    behaviors {
        /omit-if-no-ref/ caps_word: caps_word {
            compatible = "zmk,behavior-caps-word";
            #binding-cells = <0>;
            mods = <MOD_LSFT>;
            continue-list = <UNDERSCORE BACKSPACE DELETE>;
            ignore-alphas;
            ignore-numbers;
            ignore-modifiers;
            display-name = "Caps Word";
        };
    };

    behaviors {
        /omit-if-no-ref/ num_word: behavior_num_word {
            compatible = "zmk,behavior-caps-word";
            #binding-cells = <0>;
            // layers = <xx>; // to be specified in user config using "&num_word { layers = <xx>; };"
            continue-list = <BACKSPACE DELETE DOT COMMA>;
            ignore-numbers;
            display-name = "Num Word";
        };
    };
};

