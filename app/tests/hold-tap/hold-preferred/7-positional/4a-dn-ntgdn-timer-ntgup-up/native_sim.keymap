#include <dt-bindings/zmk/keys.h>
#include <behaviors.dtsi>
#include <dt-bindings/zmk/kscan_mock.h>
#include "../behavior_keymap.dtsi"

&kscan {
    events = <ZMK_MOCK_PRESS(0,0,200)
              ZMK_MOCK_PRESS(1,1,200) // non trigger key
              /* timer fires */
              ZMK_MOCK_RELEASE(1,1,10)
              ZMK_MOCK_RELEASE(0,0,10)>;
};
