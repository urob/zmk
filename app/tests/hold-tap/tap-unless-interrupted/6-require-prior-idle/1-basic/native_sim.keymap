#include <dt-bindings/zmk/keys.h>
#include <behaviors.dtsi>
#include <dt-bindings/zmk/kscan_mock.h>
#include "../behavior_keymap.dtsi"

&kscan {
    events = <
              /* tap */
              ZMK_MOCK_PRESS(0,0,10)
              ZMK_MOCK_RELEASE(0,0,250)
              /* normal quick tap */
              ZMK_MOCK_PRESS(0,0,400)
              ZMK_MOCK_RELEASE(0,0,400)
              /* hold */
              ZMK_MOCK_PRESS(0,0,400)
              ZMK_MOCK_PRESS(1,0,10)
              ZMK_MOCK_RELEASE(1,0,10)
              ZMK_MOCK_RELEASE(0,0,400)
              /* require-prior-idle */
              ZMK_MOCK_PRESS(1,0,10)
              ZMK_MOCK_PRESS(0,0,400)
              ZMK_MOCK_RELEASE(1,0,10)
              ZMK_MOCK_RELEASE(0,0,10)>;
};
